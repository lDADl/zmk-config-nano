## config/boards/shields/wyld_dm_dongle/Kconfig.defconfig
```kconfig
if SHIELD_WYLD_DM_DONGLE
  config ZMK_KEYBOARD_NAME
    default "Wyld Dongle"
  config ZMK_SPLIT_ROLE_CENTRAL
    default y
  config ZMK_SPLIT
    default y
endif
```
