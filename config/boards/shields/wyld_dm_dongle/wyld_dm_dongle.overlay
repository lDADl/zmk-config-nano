#include <dt-bindings/zmk/matrix_transform.h>

/ {
    chosen {
        zmk,kscan = &mock_kscan;
        zmk,physical-layout = &physical_layout0;
    };

    physical_layout0: physical_layout_0 {
        compatible = "zmk,physical-layout";
        display-name = "Default Layout";
    };

    mock_kscan: mock_kscan_0 {
        compatible = "zmk,kscan-mock";
        rows = <0>;
        columns = <0>;
        events = <>;
    };
};
